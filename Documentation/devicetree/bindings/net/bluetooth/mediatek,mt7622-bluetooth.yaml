## Documentation/devicetree/bindings/net/bluetooth/mediatek,mt7622-bluetooth.yaml
```yaml
# SPDX-License-Identifier: GPL-2.0-only OR BSD-2-Clause
%YAML 1.2
---
$id: http://devicetree.org/schemas/net/bluetooth/mediatek,mt7622-bluetooth.yaml#
$schema: http://devicetree.org/meta-schemas/core.yaml#

title: MediaTek SoC built-in Bluetooth

description:
  This device is a serial attached device to BTIF device and thus it must be a
  child node of the serial node with BTIF. The dt-bindings details for BTIF
  device can be known via Documentation/devicetree/bindings/serial/8250.yaml.

maintainers:
  - Sean Wang <sean.wang@mediatek.com>

allOf:
  - $ref: bluetooth-controller.yaml#

properties:
  compatible:
    const: mediatek,mt7622-bluetooth

  clocks:
    maxItems: 1

  clock-names:
    const: ref

  power-domains:
    maxItems: 1

required:
  - clocks
  - clock-names
  - power-domains

unevaluatedProperties: false

examples:
  - |
    #include <dt-bindings/clock/mt7622-clk.h>
    #include <dt-bindings/interrupt-controller/arm-gic.h>
    #include <dt-bindings/power/mt7622-power.h>

    serial@1100c000 {
        compatible = "mediatek,mt7622-btif", "mediatek,mtk-btif";
        reg = <0 0x1100c000 0 0x1000>;
        interrupts = <GIC_SPI 90 IRQ_TYPE_LEVEL_LOW>;
        clocks = <&pericfg CLK_PERI_BTIF_PD>;
        clock-names = "main";
        reg-shift = <2>;
        reg-io-width = <4>;

        bluetooth {
            compatible = "mediatek,mt7622-bluetooth";
            power-domains = <&scpsys MT7622_POWER_DOMAIN_WB>;
            clocks = <&clk25m>;
            clock-names = "ref";
        };
    };
```

## Documentation/devicetree/bindings/net/bluetooth/microchip,wilc3000-bt.yaml
```yaml
# SPDX-License-Identifier: (GPL-2.0 OR BSD-2-Clause)
%YAML 1.2
---
$id: http://devicetree.org/schemas/net/bluetooth/microchip,wilc3000-bt.yaml#
$schema: http://devicetree.org/meta-schemas/core.yaml#

title: Microchip Bluetooth chips

description:
  This binding describes UART-attached Microchip bluetooth chips. These
  chips are dual-radio chips supporting WiFi and Bluetooth. The bluetooth
  side works with standard HCI commands over 4-wires UART (with flow
  control)

maintainers:
  - Alexis Lothoré <alexis.lothore@bootlin.com>

properties:
  compatible:
    enum:
      - microchip,wilc3000-bt

  wlan:
    $ref: /schemas/types.yaml#/definitions/phandle
    description:
      Phandle to the wlan part of the combo chip

required:
  - compatible
  - wlan

additionalProperties: false

examples:
  - |
    serial {
        bluetooth {
            compatible = "microchip,wilc3000-bt";
            wlan = <&wifi>;
        };
    };
```

## Documentation/devicetree/bindings/net/bluetooth/nxp,w8xxx-bt.yaml
```yaml
# SPDX-License-Identifier: (GPL-2.0 OR BSD-2-Clause)
%YAML 1.2
---
$id: http://devicetree.org/schemas/net/bluetooth/nxp-bluetooth.yaml#
$schema: http://devicetree.org/meta-schemas/core.yaml#

title: NXP Bluetooth chips

description:
  This binding describes UART-attached NXP bluetooth chips.
  These chips are dual-radio chips supporting WiFi and Bluetooth,
  except for iw612, which is a tri-radio chip supporting 15.4
  as well.
  The bluetooth works on standard H4 protocol over 4-wire UART.
  The RTS and CTS lines are used during FW download.
  To enable power save mode, the host asserts break signal
  over UART-TX line to put the chip into power save state.
  De-asserting break wakes-up the BT chip.

maintainers:
  - Neeraj Sanjay Kale <neeraj.sanjaykale@nxp.com>

properties:
  compatible:
    enum:
      - nxp,88w8987-bt
      - nxp,88w8997-bt
      - nxp,88w9098-bt
      - nxp,iw416-bt
      - nxp,iw612-bt

required:
  - compatible

additionalProperties: false

examples:
  - |
    uart2 {
        uart-has-rtscts;
        bluetooth {
          compatible = "nxp,iw416-bt";
        };
    };
```

## Documentation/devicetree/bindings/net/bluetooth/nxp-bluetooth.yaml
```yaml
# SPDX-License-Identifier: (GPL-2.0 OR BSD-2-Clause)
%YAML 1.2
---
$id: http://devicetree.org/schemas/net/bluetooth/nxp-bluetooth.yaml#
$schema: http://devicetree.org/meta-schemas/core.yaml#

title: NXP Bluetooth chips

description:
  This binding describes UART-attached NXP bluetooth chips.

maintainers:
  - Neeraj Sanjay Kale <neeraj.sanjaykale@nxp.com>

properties:
  compatible:
    enum:
      - nxp,w8987-bt
      - nxp,w8997-bt
      - nxp,w9098-bt
      - nxp,iw416-bt
      - nxp,iw612-bt

  firmware-name:
    description:
      Specify firmware file name.

required:
  - compatible

additionalProperties: false

examples:
  - |
    uart2 {
        bluetooth {
          compatible = "nxp,iw416-bt";
          firmware-name = "uartuart_n61x_v1.bin";
        };
    };
```

## Documentation/devicetree/bindings/net/h4-bluetooth.yaml
```yaml
# SPDX-License-Identifier: (GPL-2.0-only OR BSD-2-Clause)
%YAML 1.2
---
$id: http://devicetree.org/schemas/net/h4-bluetooth.yaml#
$schema: http://devicetree.org/meta-schemas/core.yaml#

title: H4 Bluetooth

maintainers:
  - Dominique Martinet <dominique.martinet@atmark-techno.com>

description:
  H4 is a common bluetooth over uart protocol.
  For example, the AW-XM458 is a WiFi + BT module where the WiFi part is
  connected over PCI (M.2), while BT is connected over serial speaking
  the H4 protocol. Its firmware is sent on the PCI side.

properties:
  compatible:
    enum:
      - nxp,aw-xm458-bt

  max-speed: true

required:
  - compatible

additionalProperties: false

examples:
  - |
    #include <dt-bindings/gpio/gpio.h>
    #include <dt-bindings/clock/imx8mp-clock.h>

    uart1 {
        pinctrl-names = "default";
        pinctrl-0 = <&pinctrl_uart1>;
        assigned-clocks = <&clk IMX8MP_CLK_UART1>;
        assigned-clock-parents = <&clk IMX8MP_SYS_PLL1_80M>;
        status = "okay";
        fsl,dte-mode = <1>;
        fsl,uart-has-rtscts;


        bluetooth {
            compatible = "nxp,aw-xm458-bt";
            max-speed = <3000000>;
        };
    };
```

## Documentation/devicetree/bindings/net/qualcomm-bluetooth.txt
```
Qualcomm Bluetooth Chips
---------------------

This documents the binding structure and common properties for serial
attached Qualcomm devices.

Serial attached Qualcomm devices shall be a child node of the host UART
device the slave device is attached to.

Required properties:
 - compatible: should contain one of the following:
   * "qcom,qca6174-bt"
   * "qcom,qca9377-bt"
   * "qcom,wcn3990-bt"
   * "qcom,wcn3991-bt"
   * "qcom,wcn3998-bt"
   * "qcom,qca6390-bt"
   * "qcom,wcn6750-bt"

Optional properties for compatible string qcom,qca6174-bt:

 - enable-gpios: gpio specifier used to enable chip
 - clocks: clock provided to the controller (SUSCLK_32KHZ)
 - firmware-name: specify the name of nvm firmware to load

Optional properties for compatible string qcom,qca9377-bt:

 - max-speed: see Documentation/devicetree/bindings/serial/serial.yaml

Required properties for compatible string qcom,wcn399x-bt:

 - vddio-supply: VDD_IO supply regulator handle.
 - vddxo-supply: VDD_XO supply regulator handle.
 - vddrf-supply: VDD_RF supply regulator handle.
 - vddch0-supply: VDD_CH0 supply regulator handle.

Optional properties for compatible string qcom,wcn399x-bt:

 - max-speed: see Documentation/devicetree/bindings/serial/serial.yaml
 - firmware-name: specify the name of nvm firmware to load
 - clocks: clock provided to the controller

Required properties for compatible string qcom,wcn6750-bt:

 - enable-gpios: gpio specifier used to enable chip
 - swctrl-gpios: gpio specifier is output from SoC,used to find status
		 of clock supply to SoC.
 - vddio-supply: VDD_IO supply regulator handle.
 - vddaon-supply: VDD_AON supply regulator handle.
 - vddbtcxmx-suppl: VDD_BT_CXMX supply regualtor handle.
 - vddrfacmn-supply: VDD_RFA_CMN supply regulator handle.
 - vddrfa0p8-supply: VDD_RFA_0P8 suppply regulator handle.
 - vddrfa1p7-supply: VDD_RFA_1P7 supply regulator handle.
 - vddrfa1p2-supply: VDD_RFA_1P2 supply regulator handle.
 - vddrfa2p2-supply: VDD_RFA_2P2 supply regulator handle.
 - vddasd-supply: VDD_ASD supply regulator handle.

Optional properties for compatible string qcom,wcn6750-bt:

 - max-speed: see Documentation/devicetree/bindings/serial/serial.yaml
 - firmware-name: specify the name of nvm firmware to load

Examples:

serial@7570000 {
	label = "BT-UART";
	status = "okay";

	bluetooth {
		compatible = "qcom,qca6174-bt";

		enable-gpios = <&pm8994_gpios 19 GPIO_ACTIVE_HIGH>;
		clocks = <&divclk4>;
		firmware-name = "nvm_00440302.bin";
	};
};

serial@898000 {
	bluetooth {
		compatible = "qcom,wcn3990-bt";

		vddio-supply = <&vreg_s4a_1p8>;
		vddxo-supply = <&vreg_l7a_1p8>;
		vddrf-supply = <&vreg_l17a_1p3>;
		vddch0-supply = <&vreg_l25a_3p3>;
		max-speed = <3200000>;
		firmware-name = "crnv21.bin";
		clocks = <&rpmhcc RPMH_RF_CLK2>;
	};
};

serial@99c000 {
	bluetooth {
		compatible = "qcom,wcn6750-bt";

		pinctrl-names = "default";
		pinctrl-0 = <&bt_en_default>;
		enable-gpios = <&tlmm 85 GPIO_ACTIVE_HIGH>;
		swctrl-gpios = <&tlmm 86 GPIO_ACTIVE_HIGH>;
		vddio-supply = <&vreg_l19b_1p8>;
		vddaon-supply = <&vreg_s7b_0p9>;
		vddbtcxmx-supply = <&vreg_s7b_0p9>;
		vddrfacmn-supply = <&vreg_s7b_0p9>;
		vddrfa0p8-supply = <&vreg_s7b_0p9>;
		vddrfa1p7-supply = <&vreg_s1b_1p8>;
		vddrfa1p2-supply = <&vreg_s8b_1p2>;
		vddrfa2p2-supply = <&vreg_s1c_2p2>;
		vddasd-supply = <&vreg_l11c_2p8>;
		max-speed = <3200000>;
		firmware-name = "msnv11.bin";
	};
};
```
